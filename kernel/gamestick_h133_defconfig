## kernel/gamestick_h133_defconfig
```kconfig
CONFIG_ARM=y
CONFIG_ARCH_SUNXI=y
CONFIG_DEFAULT_DEVICE_TREE="allwinner/sun8i-t113s-mangopi-mq-r-t113"
CONFIG_DRAM_CLK=648
CONFIG_SPL=y
CONFIG_DRAM_SUNXI_ODT_EN=1
CONFIG_DRAM_SUNXI_TPR0=0x004a2195
CONFIG_DRAM_SUNXI_TPR11=0x460000
CONFIG_DRAM_SUNXI_TPR12=0x55
CONFIG_DRAM_SUNXI_TPR13=0x34090100
CONFIG_MACH_SUN8I_R528=y
CONFIG_DRAM_ZQ=8092667
CONFIG_SUNXI_MINIMUM_DRAM_MB=128
# CONFIG_SYS_MALLOC_CLEAR_ON_INIT is not set
CONFIG_CONS_INDEX=1
```
